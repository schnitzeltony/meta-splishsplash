## conf/layer.conf
```bitbake
# We have a conf directory, append to BBPATH
BBPATH .= ":${LAYERDIR}"

# We have a recipes directory, add to BBFILES
BBFILES += "${LAYERDIR}/recipes*/*.bb ${LAYERDIR}/recipes*/*/*.bb"
# appends
#BBFILES += "${LAYERDIR}/extends-*/*.bb ${LAYERDIR}/extends-*/*.bbappend"

BBFILE_COLLECTIONS += "meta-splishsplash"
BBFILE_PATTERN_meta-splishsplash := "^${LAYERDIR}/"
BBFILE_PRIORITY_meta-splishsplash = "10"

#LICENSE_PATH += "${LAYERDIR}/files/licenses"

LAYERDEPENDS_meta-splishsplash = "core openembedded-layer"
LAYERSERIES_COMPAT_meta-splishsplash = "dunfell gatesgarth"
```
